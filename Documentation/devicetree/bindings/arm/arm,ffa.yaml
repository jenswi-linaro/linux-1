## Documentation/devicetree/bindings/arm/arm,ffa.yaml
```yaml
# SPDX-License-Identifier: (GPL-2.0-only OR BSD-2-Clause)
%YAML 1.2
---
$id: http://devicetree.org/schemas/arm/arm,ffa.yaml#
$schema: http://devicetree.org/meta-schemas/core.yaml#

title: Arm Firmware Framework for Arm v8-A (in-kernel users)

maintainers:
  - Sudeep Holla <sudeep.holla@arm.com>

description: |
  Firmware frameworks implementing partition according to the FF-A
  specification defined by ARM document number ARM DEN 0077A ("Arm Firmware
  Framework for Arm v8-A") [0], providing services to be used by other
  partitions.

  [0] https://developer.arm.com/docs/den0077/latest

properties:
  $nodename:
    const: ffa

  compatible:
    oneOf:
      - const: arm,ffa-1.0

patternProperties:
  "^ffa_partition[0-9]+$":
    type: object
    description: One or more child nodes, each describing an FFA partition.
    properties:
      $nodename:
        const: ffa_partition

      compatible:
        oneOf:
          - const: arm,ffa-1.0-partition

      uuid:
        $ref: '/schemas/types.yaml#definitions/string'
        description: |
          The 128-bit UUID [2] of the service implemented by this partition.

          [2] https://tools.ietf.org/html/rfc4122

additionalProperties: false

examples:
  - |
    ffa {
      compatible = "arm,ffa-1.0";

      ffa_partition0 {
        compatible = "arm,ffa-1.0-partition";
        uuid = "12345678-9abc-def0-1234-56789abcdef0";
      };
    };
```

## Documentation/devicetree/bindings/reserved-memory/mediatek,dynamic-restricted-region.yaml
```yaml
# SPDX-License-Identifier: (GPL-2.0-only OR BSD-2-Clause)
%YAML 1.2
---
$id: http://devicetree.org/schemas/reserved-memory/mediatek,dynamic-restricted-region.yaml#
$schema: http://devicetree.org/meta-schemas/core.yaml#

title: MediaTek Dynamic Reserved Region

description:
  A memory region that can dynamically transition as a whole between
  secure and non-secure states. This memory will be protected by OP-TEE
  when allocations are active and unprotected otherwise.

maintainers:
  - Yong Wu <yong.wu@mediatek.com>

allOf:
  - $ref: reserved-memory.yaml

properties:
  compatible:
    const: mediatek,dynamic-restricted-region

required:
  - compatible
  - reg
  - reusable

unevaluatedProperties: false

examples:
  - |
    reserved-memory {
        #address-cells = <1>;
        #size-cells = <1>;
        ranges;

        reserved-memory@80000000 {
            compatible = "mediatek,dynamic-restricted-region";
            reg = <0x80000000 0x18000000>;
            reusable;
        };
    };
```

## drivers/dma-buf/heaps/Kconfig
```kconfig
config DMABUF_HEAPS_SYSTEM
	bool "DMA-BUF System Heap"
	depends on DMABUF_HEAPS
	help
	  Choose this option to enable the system dmabuf heap. The system heap
	  is backed by pages from the buddy allocator. If in doubt, say Y.

config DMABUF_HEAPS_CMA
	bool "DMA-BUF CMA Heap"
	depends on DMABUF_HEAPS && DMA_CMA
	help
	  Choose this option to enable dma-buf CMA heap. This heap is backed
	  by the Contiguous Memory Allocator (CMA). If your system has these
	  regions, you should say Y here.

config DMABUF_HEAPS_RESTRICTED
	bool "DMA-BUF Restricted Heap"
	depends on DMABUF_HEAPS
	help
	  Choose this option to enable dma-buf restricted heap. The purpose of this
	  heap is to manage buffers that are inaccessible to the kernel and user space.
	  There may be several ways to restrict it, for example it may be encrypted or
	  protected by a TEE or hypervisor. If in doubt, say N.

config DMABUF_HEAPS_RESTRICTED_MTK
	bool "MediaTek DMA-BUF Restricted Heap"
	depends on DMABUF_HEAPS_RESTRICTED && TEE=y
	help
	  Enable restricted dma-buf heaps for MediaTek platform. This heap is backed by
	  TEE client interfaces. If in doubt, say N.
```

## drivers/rpmb/Kconfig
```kconfig
# SPDX-License-Identifier: GPL-2.0
# Copyright (c) 2015-2019, Intel Corporation.

config RPMB
	tristate "RPMB partition interface"
	help
	  Unified RPMB partition interface for RPMB capable devices such as
          eMMC and UFS. Provides interface for in kernel security controllers to
	  access RPMB partition.

	  If unsure, select N.

config RPMB_INTF_DEV
	bool "RPMB character device interface /dev/rpmbN"
	depends on RPMB
	help
	  Say yes here if you want to access RPMB from user space
	  via character device interface /dev/rpmb%d

config VIRTIO_RPMB
	tristate "Virtio RPMB driver"
	default n
	depends on VIRTIO
	select RPMB
	help
	  Say yes here if you have a Virtio aware RPMB device or want to use
          RPMB from a Virtual Machine images.
	  This device interface is only for guest/frontend virtio driver.
```
